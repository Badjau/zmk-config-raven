## boards/shields/raven/Kconfig.shield
```kconfig
config SHIELD_RAVEN_LEFT
    def_bool $(shields_list_contains,raven_left)

config SHIELD_RAVEN_RIGHT
    def_bool $(shields_list_contains,raven_right)
```

## config/west.yml
```yaml
manifest:
  remotes:
    - name: zmkfirmware
      url-base: https://github.com/zmkfirmware
    # support nice_oled and nice_epaper
    - name: badjau
      url-base: https://github.com/badjau
    # Additional modules containing boards/shields/custom code can be listed here as well
    # See https://docs.zephyrproject.org/3.2.0/develop/west/manifest.html#projects
  projects:
    - name: zmk
      remote: zmkfirmware
      revision: main
      import: app/west.yml
    - name: zmk-nice-oled
      remote: badjau
      revision: main
  self:
    path: config  
    
```
